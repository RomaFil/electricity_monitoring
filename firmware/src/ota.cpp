#include "ota.h"

#include <ESP8266WiFi.h>
#include <ESP8266httpUpdate.h>
#include <LittleFS.h>
#include <WiFiClientSecureBearSSL.h>

#include "display.h"
// Generated by signing.py from firmware/public.key; SIGNING_PUBKEY is "" when there is no key.
#include "signing_key.h"

String otaStatus;

static const char *PENDING_FILE = "/ota_pending";
static const char *RESULT_FILE = "/ota_result";
static const char *RELEASE_URL = "https://github.com/RomaFil/electricity_monitoring/releases/download/v";
static const uint32_t WIFI_WAIT_MS = 60000;

static bool signedOnly = false;

static String readFile(const char *path) {
  File f = LittleFS.open(path, "r");
  if (!f) return "";
  String s = f.readString();
  f.close();
  s.trim();
  return s;
}

static void writeFile(const char *path, const String &s) {
  File f = LittleFS.open(path, "w");
  if (!f) return;
  f.print(s);
  f.close();
}

void otaSignatureBegin() {
  if (!strlen(SIGNING_PUBKEY)) {
    Serial.println(F("OTA: no public.key at build time, any image is accepted, remote updates are off"));
    return;
  }
  // Kept for the whole run: Update checks every image against them, the /update page included.
  static BearSSL::PublicKey key(SIGNING_PUBKEY);
  static BearSSL::HashSHA256 hash;
  static BearSSL::SigningVerifier verifier(&key);
  // A key that did not parse would make the verifier expect no signature at all and accept anything.
  if (!key.isRSA()) {
    Serial.println(F("OTA: public.key did not parse, remote updates are off"));
    return;
  }
  Update.installSignature(&hash, &verifier);
  signedOnly = true;
  Serial.println(F("OTA: only images signed with private.key are accepted"));
}

bool otaSigned() { return signedOnly; }

bool otaVersionOk(const String &v) {
  if (!v.length() || v.length() > 12) return false;
  int dots = 0;
  bool digit = false;
  for (char ch : v) {
    if (ch == '.') {
      if (!digit) return false;
      dots++;
      digit = false;
    } else if (isdigit((unsigned char)ch)) {
      digit = true;
    } else {
      return false;
    }
  }
  return digit && dots >= 1 && dots <= 3;
}

bool otaRequest(const String &version) {
  writeFile(PENDING_FILE, version);
  return readFile(PENDING_FILE) == version;
}

static void show(const String &msg) {
  displayNote = msg;
  displayLoop();
}

void otaBoot(ESP8266WiFiMulti &multi) {
  // "try 0.7.1" survives the restart into the new image: if we now run 0.7.1, it worked.
  String res = readFile(RESULT_FILE);
  if (res.startsWith("try ")) {
    String ver = res.substring(4);
    res = ver == FW_VERSION ? ver + F(" встановлено") : ver + F(" не встановилось, працює ") + FW_VERSION;
    writeFile(RESULT_FILE, res);
  }
  otaStatus = res;

  String ver = readFile(PENDING_FILE);
  if (!ver.length()) return;
  LittleFS.remove(PENDING_FILE);  // before anything else: a crash below must not repeat the attempt forever
  String fail;
  if (!signedOnly) fail = F("прошивка без перевірки підпису");
  else if (!otaVersionOk(ver)) fail = F("неправильна версія");
  else if (ver == FW_VERSION) fail = F("ця версія вже стоїть");
  if (fail.length()) {
    otaStatus = ver + F(" відхилено: ") + fail;
    writeFile(RESULT_FILE, otaStatus);
    return;
  }

  Serial.printf("OTA: updating to %s, heap %u\n", ver.c_str(), ESP.getFreeHeap());
  show(String(F("fw ")) + ver + F("..."));
  uint32_t start = millis();
  while (multi.run(5000) != WL_CONNECTED && millis() - start < WIFI_WAIT_MS) delay(100);
  if (WiFi.status() != WL_CONNECTED) {
    otaStatus = ver + F(" не встановилось: немає Wi-Fi");
    writeFile(RESULT_FILE, otaStatus);
    show("");
    return;
  }

  writeFile(RESULT_FILE, String(F("try ")) + ver);
  // Download right after boot, while the heap is still free: TLS needs a 16 KB buffer here.
  BearSSL::WiFiClientSecure client;
  // The image is trusted because of its RSA signature, checked before the switch, not because of TLS.
  // GitHub sends the file from a CDN whose certificates change too often to pin them here.
  client.setInsecure();
  client.setTimeout(20000);
  ESPhttpUpdate.setFollowRedirects(HTTPC_FORCE_FOLLOW_REDIRECTS);  // github.com -> release-assets CDN
  ESPhttpUpdate.rebootOnUpdate(true);
  ESPhttpUpdate.onProgress([](int done, int total) {
    if (total > 0) show(String(F("fw update ")) + (done * 100 / total) + '%');
  });
  ESPhttpUpdate.update(client, String(RELEASE_URL) + ver + F("/firmware.bin.signed"));

  // Only a failure gets here: on success the board has already restarted into the new image.
  otaStatus = ver + F(" не встановилось: ") + ESPhttpUpdate.getLastErrorString();
  Serial.println(otaStatus);
  writeFile(RESULT_FILE, otaStatus);
  show("");
}
